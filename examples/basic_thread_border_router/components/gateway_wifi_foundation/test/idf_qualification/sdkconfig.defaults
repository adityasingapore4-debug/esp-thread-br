## examples/basic_thread_border_router/main/Kconfig.projbuild
```kconfig
menu "Universal Node Gateway profile"

config UN_MEMBERSHIP_LIFECYCLE_HOST
    bool "Advertise Membership Lifecycle Host capability"
    default y
    help
        Advertise the existing V2 Membership Lifecycle Host capability.
        This is a Universal Node capability, not a Gateway-specific role.

config UN_GATEWAY_G1A_ENABLE_PRODUCT_TRAFFIC
    bool "Enable Gateway/OTBR product traffic"
    default n
    help
        G1A keeps the canonical Universal Node foundation isolated.  Enabling
        this starts the existing engineering Gateway HTTP carrier and OTBR
        runtime; that is outside the G1A profile.

config UN_GATEWAY_DEV_P4_AUTH_PREPARE
    bool "Prepare P4 Local authentication runtime (development only)"
    depends on !UN_GATEWAY_G1A_ENABLE_PRODUCT_TRAFFIC
    default n
    help
        Initialize the existing ADR-073 Local authentication transaction table,
        ADR-074 Local session service and P4 access-token association owner
        in G1E mode. This opt-in preparation does not start Wi-Fi, a P4 HTTPS
        listener, Gateway product traffic, or any P4 identity/key provider.
        It must not be enabled in a release configuration.

config UN_GATEWAY_DEV_P4_TLS_SMOKE
    bool "TLS-only P4 server smoke test (development only)"
    depends on UN_GATEWAY_DEV_P4_AUTH_PREPARE
    depends on OPENTHREAD_CLI_WIFI
    depends on !SECURE_BOOT && !SECURE_FLASH_ENC_ENABLED
    default n
    help
        Builds a deliberately ephemeral RAM-only mock P4 storage provider.
        Reuses saved Wi-Fi settings with the existing Gateway Wi-Fi helper;
        missing settings leave the listener inactive. No SSID/password is
        embedded in firmware, and no SoftAP fallback is enabled.
        Starts the existing ESP-IDF HTTPS owner with NO registered HTTP routes;
        authentication and product ingress remain disabled. No production
        P4 identity, eFuse, persistent NVS, or Thread Dataset changes.
        Production Secure Boot / Flash Encryption profiles cannot enable it.
        An independently verified client connection additionally requires
        a trusted manufacturer/installation/P4 proof supplied out of band.

config UN_GATEWAY_DEV_PSRAM
    bool "FC61 N8R2 PSRAM memory qualification (development only)"
    depends on UN_GATEWAY_DEV_P4_TLS_SMOKE && SPIRAM
    default n
    help
        Marks the separately selected development PSRAM profile. Require
        successful 2 MiB PSRAM initialization and heap integration before
        canonical Gateway services start. Does not initialize hardware twice,
        change commissioning state or alter the production memory defaults.

endmenu
```
